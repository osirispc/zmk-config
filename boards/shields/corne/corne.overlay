/ {
    chosen {
        zmk,underglow = &led_strip;
    };

    led_strip: led_strip {
        compatible = "zmk,rgb-underglow";
        chain-length = <27>;
        color-order = <2 1 0>;
    };
};
