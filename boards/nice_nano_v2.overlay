/ {
    chosen {
        zmk,underglow = &underglow;
    };

    underglow: underglow {
        compatible = "worldsemi,ws2812-spi";
        chain-length = <6>;
        color-mapping = <1 0 2>;
        spi-dev = <&spi1>;
    };
};

&spi1 {
    status = "okay";
};
