/ {
    behaviors {
        /* Home-row mod-taps tuned for split + BLE */
        homerow_mods: homerow_mods {
            compatible = "zmk,behavior-hold-tap";
            label = "HRM";
            #binding-cells = <2>;
            flavor = "balanced";
            quick-tap-ms = <175>;
            tapping-term-ms = <260>;
            require-prior-idle-ms = <70>;
            bindings = <&kp>, <&kp>;
        };
    };
};
